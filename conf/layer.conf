## conf/layer.conf
```bitbake
# We have a conf and classes directory, append to BBPATH
BBPATH .= ":${LAYERDIR}"

# We have a recipes directory, add to BBFILES
BBFILES += "${LAYERDIR}/recipes*/*/*.bb ${LAYERDIR}/recipes*/*/*.bbappend"



BBFILE_COLLECTIONS += "meta-domoticz"
BBFILE_PATTERN_meta-domoticz = "^${LAYERDIR}/"
BBFILE_PRIORITY_meta-domoticz = "10"

LAYERSERIES_COMPAT_meta-domoticz = "thud"
```
